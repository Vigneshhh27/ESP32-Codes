#include <Wire.h>
#include <Adafruit_GFX.h>
#include <Adafruit_SSD1306.h>

#define SCREEN_WIDTH 128    // OLED display width, in pixels
#define SCREEN_HEIGHT 64    // OLED display height, in pixels
#define OLED_RESET    -1    // Reset pin # (or -1 if not used)
#define SCREEN_ADDRESS 0x3C // I2C address (verify with an I2C scanner)





// Subclass to expose a public contrast setter
class MySSD1306 : public Adafruit_SSD1306 {
public:
  using Adafruit_SSD1306::Adafruit_SSD1306; // Inherit constructors
  void setMyContrast(uint8_t c) {
    ssd1306_command(SSD1306_SETCONTRAST);
    ssd1306_command(c);
  }
};





// Initialize the display object
//Adafruit_SSD1306 display(SCREEN_WIDTH, SCREEN_HEIGHT, &Wire, OLED_RESET);
MySSD1306 display(SCREEN_WIDTH, SCREEN_HEIGHT, &Wire, OLED_RESET);
//
// Global sensor variables (example values)
int temperature = 25;   // Temperature value (e.g., 25°C)
int humidity    = 50; // Humidity in %
int waterLevel  = 75; // Water level in cm
int   aqi         = 100;  // Air Quality Index

// Thermometer bitmap (128x64) – replace this with your actual data.

const unsigned char thermometerthermometerthermo3 [] PROGMEM =  {
	0x00, 0x00, 0x00, 0x00, 0x00, 0x00, 0x00, 0x00, 0x00, 0x00, 0x00, 0x00, 0x00, 0x00, 0x00, 0x00, 
	0x00, 0x00, 0x00, 0x00, 0x00, 0x00, 0x00, 0x00, 0x00, 0x00, 0x00, 0x00, 0x00, 0x00, 0x00, 0x00, 
	0x00, 0x00, 0x00, 0x00, 0x00, 0x00, 0x00, 0x00, 0x00, 0x00, 0x00, 0x00, 0x00, 0x00, 0x00, 0x00, 
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	0x00, 0x00, 0x00, 0x00, 0x00, 0x00, 0x00, 0x00, 0x00, 0x00, 0x00, 0x00, 0x00, 0x00, 0x00, 0x00
};



//---------------------------
// Slide 1: Thermometer Bitmap with Temperature Overlay
//---------------------------
void slide_temperature() {
  display.clearDisplay();

  display.setTextSize(1);            // Use an integer text size (Adafruit_GFX supports only integers)
  display.setTextColor(SSD1306_WHITE);
  display.cp437(true);
  
  // Compute bounding box of the text "Temperature"
  int16_t x1, y1;
  uint16_t w, h;
  display.getTextBounds(F("Temperature"), 0, 0, &x1, &y1, &w, &h);
  
  // Calculate x so that the text is centered
  int cursorX = (SCREEN_WIDTH - w) / 2;
  
  display.setCursor(cursorX, 0);
  display.print(F("Temperature"));
  
  // Draw the fire bitmap covering the whole screen starting at (0,0)
  //display.drawBitmap(0, 0, firebitmapfir, SCREEN_WIDTH, SCREEN_HEIGHT, SSD1306_WHITE);
 // display.drawBitmap(0, 0, thermometerthermometer, SCREEN_WIDTH, SCREEN_HEIGHT, SSD1306_WHITE);
  display.drawBitmap(0, 0, thermometerthermometerthermo3, SCREEN_WIDTH, SCREEN_HEIGHT, SSD1306_WHITE);

  
   // Now display a two-digit temperature (with °C) on the right half.
  // We'll use textSize 3 so that the characters are large.
  display.setTextSize(3);
  display.setTextColor(SSD1306_WHITE);
  // Calculate vertical centering. Default font is ~8 pixels tall; with textSize 3: 8*3=24 pixels tall.
  int textY =   26; //(SCREEN_HEIGHT - 24) / 2;  // (64-24)/2 = 20
  // Place the text in the right half (starting a few pixels after column 64).
  display.setCursor(51, textY);
  display.print(temperature);

  // Using CP437, character code 223 often renders as a degree symbol.
  //display.write(223);
  int degreeX = 51 + 32 + 3 + 6;  // shift right by an offset
  int degreeY = textY - 3;      // position slightly above the text baseline
  
  // Draw a filled circle to represent the degree symbol
  display.fillCircle(degreeX, degreeY, 2, SSD1306_WHITE);
  // Now print "C" after the circle.
  // Add additional offset (e.g., 6 pixels) so that there's a gap of 3-4 pixels between circle and "C".
  display.setCursor(degreeX + 6, textY);
  display.print("C");
  
  display.display();
  delay(5000);  // Hold slide 1 for 5 seconds
}

//---------------------------
// Slide 2: Detailed Sensor Values
//---------------------------
void slide_ALL_DATA() {
  display.clearDisplay();
  display.setTextSize(2);           // Decent font size (2x scaling)
  display.setTextColor(SSD1306_WHITE);
  display.cp437(true);              // Enable full 256-char font for CP437
  
  // Line 1: Temperature
  display.setCursor(0, 0);
  display.print(F("Temp: "));
  display.print(temperature, 1);
  // Use a built-in degree symbol (or adjust if needed)
  //display.write(223);
  //display.print(F("C"));

    // Get current cursor position after printing temperature.
  int curX = display.getCursorX();
  int curY = display.getCursorY(); // Text baseline

  // Draw a small filled circle as the degree symbol.
  // Adjust offsets: here we move 2 pixels to the right and 3 pixels above the baseline.
  display.fillCircle(curX + 2, curY , 2, SSD1306_WHITE);

  // Set cursor a few pixels to the right of the circle (e.g. +6 pixels)
  display.setCursor(curX + 8, curY);
  display.print(F("C"));
    





  // Line 2: Humidity
  display.setCursor(0, 16);
  display.print(F("Hum: "));
  display.print(humidity, 1);
  display.print(F("%"));
  
  // Line 3: Water Level
  display.setCursor(0, 32);
  display.print(F("Water: "));
  display.print(waterLevel, 1);
  display.print(F("%"));
  
  // Line 4: AQI
  display.setCursor(0, 48);
  display.print(F("AQI: "));
  display.print(aqi,1);
  display.print(F("%"));
  
  display.display();
  delay(5000);  // Hold slide 2 for 5 seconds
}

// --- Brightness Pulse Function ---
// Smoothly increases brightness (contrast) from minContrast to maxContrast and back,
// repeating for a given number of cycles with a small delay between steps.
void pulseBrightness(uint8_t minContrast, uint8_t maxContrast, int cycles, int stepDelay) {
  for (int i = 0; i < cycles; i++) {
    // Fade in: from minContrast to maxContrast
    for (uint8_t c = minContrast; c <= maxContrast; c += 5) {
      display.setMyContrast(c);
      display.display();
      delay(stepDelay);
    }
    // Fade out: from maxContrast to minContrast
    for (int c = maxContrast; c >= minContrast; c -= 5) {
      display.setMyContrast(c);
      display.display();
      delay(stepDelay);
    }
  }
  // Restore full brightness at end.
  display.setMyContrast(maxContrast);
  display.display();
}

int stepDelay=1;


void fadein(){

      display.setMyContrast(10);
      display.display();
      delay(stepDelay);
      display.setMyContrast(20);
      display.display();
      delay(stepDelay);
      display.setMyContrast(30);
      display.display();
      delay(stepDelay);
      display.setMyContrast(40);
      display.display();
      delay(stepDelay);
      display.setMyContrast(50);
      display.display();
      delay(stepDelay);
      display.setMyContrast(60);
      display.display();
      delay(stepDelay);
      display.setMyContrast(70);
      display.display();
      delay(stepDelay);
      display.setMyContrast(80);
      display.display();
      delay(stepDelay);
      display.setMyContrast(90);
      display.display();
      delay(stepDelay);
      display.setMyContrast(100);
      display.display();
      delay(stepDelay);

}


void fadeout(){
  display.setMyContrast(100);
      display.display();
      delay(stepDelay);
      display.setMyContrast(90);
      display.display();
      delay(stepDelay);
      display.setMyContrast(80);
      display.display();
      delay(stepDelay);
      display.setMyContrast(70);
      display.display();
      delay(stepDelay);
      display.setMyContrast(60);
      display.display();
      delay(stepDelay);
      display.setMyContrast(50);
      display.display();
      delay(stepDelay);
      display.setMyContrast(40);
      display.display();
      delay(stepDelay);
      display.setMyContrast(30);
      display.display();
      delay(stepDelay);
      display.setMyContrast(20);
      display.display();
      delay(stepDelay);
      display.setMyContrast(10);
      display.display();
      delay(stepDelay);
}





#define NUMFLAKES     10 // Number of snowflakes in the animation example

#define LOGO_HEIGHT   16
#define LOGO_WIDTH    16
static const unsigned char PROGMEM logo_bmp[] =
{ 0b00000000, 0b11000000,
  0b00000001, 0b11000000,
  0b00000001, 0b11000000,
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  0b00000000, 0b00110000 };


#define XPOS   0 // Indexes into the 'icons' array in function below
#define YPOS   1
#define DELTAY 2
void testanimate(const uint8_t *bitmap, uint8_t w, uint8_t h) {
  int8_t f, icons[NUMFLAKES][3];

  // Initialize 'snowflake' positions
  for (f = 0; f < NUMFLAKES; f++) {
    icons[f][XPOS]   = random(1 - LOGO_WIDTH, display.width());
    icons[f][YPOS]   = -LOGO_HEIGHT;
    icons[f][DELTAY] = random(1, 6);
    Serial.print(F("x: "));
    Serial.print(icons[f][XPOS], DEC);
    Serial.print(F(" y: "));
    Serial.print(icons[f][YPOS], DEC);
    Serial.print(F(" dy: "));
    Serial.println(icons[f][DELTAY], DEC);
  }
  
  unsigned long startTime = millis();
  // Run the animation for 1000 milliseconds (1 second)
  while (millis() - startTime < 4000) {
    display.clearDisplay(); // Clear the display buffer

    // Draw each snowflake:
    for (f = 0; f < NUMFLAKES; f++) {
      display.drawBitmap(icons[f][XPOS], icons[f][YPOS], bitmap, w, h, SSD1306_WHITE);
    }
    
    display.display();      // Update the screen
    delay(200);             // Pause for 200 ms

    // Update coordinates for each flake
    for (f = 0; f < NUMFLAKES; f++) {
      icons[f][YPOS] += icons[f][DELTAY];
      // If snowflake is off the bottom, reinitialize it
      if (icons[f][YPOS] >= display.height()) {
        icons[f][XPOS]   = random(1 - LOGO_WIDTH, display.width());
        icons[f][YPOS]   = -LOGO_HEIGHT;
        icons[f][DELTAY] = random(1, 6);
      }
    }
  }
}



const unsigned char humidityicon [] PROGMEM = {
	0x00, 0x00, 0x00, 0x00, 0x00, 0x00, 0x00, 0x00, 0x00, 0x00, 0x00, 0x00, 0x00, 0x00, 0x00, 0x00, 
	0x00, 0x00, 0x00, 0x00, 0x00, 0x00, 0x00, 0x00, 0x00, 0x00, 0x00, 0x00, 0x00, 0x00, 0x00, 0x00, 
	0x00, 0x00, 0x00, 0x00, 0x00, 0x00, 0x00, 0x00, 0x00, 0x00, 0x00, 0x00, 0x00, 0x00, 0x00, 0x00, 
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	0x00, 0x00, 0x00, 0x00, 0x00, 0x00, 0x00, 0x00, 0x00, 0x00, 0x00, 0x00, 0x00, 0x00, 0x00, 0x00
};

void slide_Humidity() {

  display.clearDisplay();

   display.setTextSize(1);            // Use an integer text size (Adafruit_GFX supports only integers)
  display.setTextColor(SSD1306_WHITE);
  display.cp437(true);
  
  // Compute bounding box of the text "Temperature"
  int16_t x1, y1;
  uint16_t w, h;
  display.getTextBounds(F("Humidity"), 0, 0, &x1, &y1, &w, &h);
  
  // Calculate x so that the text is centered
  int cursorX = (SCREEN_WIDTH - w) / 2;
  
  display.setCursor(cursorX, 0);
  display.print(F("Humidity"));
  
  // Draw the fire bitmap covering the whole screen starting at (0,0)
  //display.drawBitmap(0, 0, firebitmapfir, SCREEN_WIDTH, SCREEN_HEIGHT, SSD1306_WHITE);
 // display.drawBitmap(0, 0, thermometerthermometer, SCREEN_WIDTH, SCREEN_HEIGHT, SSD1306_WHITE);
  display.drawBitmap(0, 0, humidityicon, SCREEN_WIDTH, SCREEN_HEIGHT, SSD1306_WHITE);

  
   // Now display a two-digit temperature (with °C) on the right half.
  // We'll use textSize 3 so that the characters are large.
  display.setTextSize(3);
  display.setTextColor(SSD1306_WHITE);
  // Calculate vertical centering. Default font is ~8 pixels tall; with textSize 3: 8*3=24 pixels tall.
  int textY =  26; //(SCREEN_HEIGHT - 24) / 2;  // (64-24)/2 = 20
  // Place the text in the right half (starting a few pixels after column 64).
  display.setCursor(54, textY);
  display.print(humidity);

  


  
  display.print(F("%"));
 
  
  display.display();
  delay(5000);  // Hold slide 1 for 5 seconds


}

const unsigned char aqi_logo [] PROGMEM = {
	0x00, 0x00, 0x00, 0x00, 0x00, 0x00, 0x00, 0x00, 0x00, 0x00, 0x00, 0x00, 0x00, 0x00, 0x00, 0x00, 
	0x00, 0x00, 0x00, 0x00, 0x00, 0x00, 0x00, 0x00, 0x00, 0x00, 0x00, 0x00, 0x00, 0x00, 0x00, 0x00, 
	0x00, 0x00, 0x00, 0x00, 0x00, 0x00, 0x00, 0x00, 0x00, 0x00, 0x00, 0x00, 0x00, 0x00, 0x00, 0x00, 
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	0x00, 0x00, 0x00, 0x00, 0x00, 0x00, 0x00, 0x00, 0x00, 0x00, 0x00, 0x00, 0x00, 0x00, 0x00, 0x00
};

void slide_AQI() {

  display.clearDisplay();
   display.setTextSize(1);            // Use an integer text size (Adafruit_GFX supports only integers)
  display.setTextColor(SSD1306_WHITE);
  display.cp437(true);
  
  // Compute bounding box of the text "Temperature"
  int16_t x1, y1;
  uint16_t w, h;
  display.getTextBounds(F("AQI"), 0, 0, &x1, &y1, &w, &h);
  
  // Calculate x so that the text is centered
  int cursorX = (SCREEN_WIDTH - w) / 2;
  
  display.setCursor(cursorX, 0);
  display.print(F("AQI"));
  
  // Draw the fire bitmap covering the whole screen starting at (0,0)
  //display.drawBitmap(0, 0, firebitmapfir, SCREEN_WIDTH, SCREEN_HEIGHT, SSD1306_WHITE);
 // display.drawBitmap(0, 0, thermometerthermometer, SCREEN_WIDTH, SCREEN_HEIGHT, SSD1306_WHITE);
  display.drawBitmap(0, 0, aqi_logo, SCREEN_WIDTH, SCREEN_HEIGHT, SSD1306_WHITE);

  
   // Now display a two-digit temperature (with °C) on the right half.
  // We'll use textSize 3 so that the characters are large.
  display.setTextSize(3);
  display.setTextColor(SSD1306_WHITE);
  // Calculate vertical centering. Default font is ~8 pixels tall; with textSize 3: 8*3=24 pixels tall.
  int textY =  26; //(SCREEN_HEIGHT - 24) / 2;  // (64-24)/2 = 20
  // Place the text in the right half (starting a few pixels after column 64).
  display.setCursor(54, textY);
  display.print(aqi);

  
  
  display.print(F("%"));
 
  
  display.display();
  delay(5000);  // Hold slide 1 for 5 seconds


}

const unsigned char WATERLEVEL_LOGO [] PROGMEM = {
	0x00, 0x00, 0x00, 0x00, 0x00, 0x00, 0x00, 0x00, 0x00, 0x00, 0x00, 0x00, 0x00, 0x00, 0x00, 0x00, 
	0x00, 0x00, 0x00, 0x00, 0x00, 0x00, 0x00, 0x00, 0x00, 0x00, 0x00, 0x00, 0x00, 0x00, 0x00, 0x00, 
	0x00, 0x00, 0x00, 0x00, 0x00, 0x00, 0x00, 0x00, 0x00, 0x00, 0x00, 0x00, 0x00, 0x00, 0x00, 0x00, 
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	0x00, 0x00, 0x00, 0x00, 0x00, 0x00, 0x00, 0x00, 0x00, 0x00, 0x00, 0x00, 0x00, 0x00, 0x00, 0x00
};


void slide_WaterLevel() {

   display.clearDisplay();
   display.setTextSize(1);            // Use an integer text size (Adafruit_GFX supports only integers)
  display.setTextColor(SSD1306_WHITE);
  display.cp437(true);
  
  // Compute bounding box of the text "Temperature"
  int16_t x1, y1;
  uint16_t w, h;
  display.getTextBounds(F("Water Level"), 0, 0, &x1, &y1, &w, &h);
  
  // Calculate x so that the text is centered
  int cursorX = (SCREEN_WIDTH - w) / 2;
  
  display.setCursor(cursorX, 0);
  display.print(F("Water Level"));



  // Draw the fire bitmap covering the whole screen starting at (0,0)
  //display.drawBitmap(0, 0, firebitmapfir, SCREEN_WIDTH, SCREEN_HEIGHT, SSD1306_WHITE);
 // display.drawBitmap(0, 0, thermometerthermometer, SCREEN_WIDTH, SCREEN_HEIGHT, SSD1306_WHITE);
  display.drawBitmap(0, 0, WATERLEVEL_LOGO, SCREEN_WIDTH, SCREEN_HEIGHT, SSD1306_WHITE);

  
   // Now display a two-digit temperature (with °C) on the right half.
  // We'll use textSize 3 so that the characters are large.
  display.setTextSize(3);
  display.setTextColor(SSD1306_WHITE);
  // Calculate vertical centering. Default font is ~8 pixels tall; with textSize 3: 8*3=24 pixels tall.
  int textY =  26; //(SCREEN_HEIGHT - 24) / 2;  // (64-24)/2 = 20
  // Place the text in the right half (starting a few pixels after column 64).
  display.setCursor(54, textY);
  display.print(waterLevel);


  

  
  
  display.print(F("%"));
 
  
  display.display();
  delay(5000);  // Hold slide 1 for 5 seconds


}








// --- Slide Show Cycle ---
// Runs each slide, holds it, then applies the pulse effect.
void runSlideShow() {

          
      slide_temperature();





      //delay(5000);  // Hold slide 1 for 5 seconds
      testanimate(logo_bmp, LOGO_WIDTH, LOGO_HEIGHT); // Animate bitmaps


      slide_Humidity();



    testanimate(logo_bmp, LOGO_WIDTH, LOGO_HEIGHT); // Animate bitmaps

    

    slide_AQI();

    testanimate(logo_bmp, LOGO_WIDTH, LOGO_HEIGHT); // Animate bitmaps

    slide_WaterLevel();
    testanimate(logo_bmp, LOGO_WIDTH, LOGO_HEIGHT); // Animate bitmaps






          
      slide_ALL_DATA();
     

      
  


      //delay(5000);  // Hold slide 2 for 5 seconds
      testanimate(logo_bmp, LOGO_WIDTH, LOGO_HEIGHT); // Animate bitmaps

      
  //pulseBrightness(50, 255, 2, 20);  // Pulse brightness for 2 cycles
}


#define OLED_SDA 21
#define OLED_SCL 27



void setup() {
  Serial.begin(115200);


   Wire.begin(OLED_SDA, OLED_SCL);
  
  if (!display.begin(SSD1306_SWITCHCAPVCC, SCREEN_ADDRESS)) {
    Serial.println(F("SSD1306 allocation failed"));
    for (;;);
  }
  display.clearDisplay();
  display.display();
}

void loop() {
  runSlideShow();
}